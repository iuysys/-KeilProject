#include "LQ12864.h"


const unsigned char code F6x8[][6] =
{
    { 0x00, 0x00, 0x00, 0x00, 0x00, 0x00 },   //sp0
    { 0x00, 0x00, 0x00, 0x2f, 0x00, 0x00 },   // !1
    { 0x00, 0x00, 0x07, 0x00, 0x07, 0x00 },   // "2
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    { 0x14, 0x14, 0x14, 0x14, 0x14, 0x14 }    // horiz lines91
};



//======================================================
// 128X64OLCD液晶底层驱动[8X16]字体库
// 设计者: Guokaiyi
// 描  述: [8X16]西文字符的字模数据 (纵向取模,字节倒序)
// !"#$%&'()*+,-./0123456789:;<=>?@ABCDEFGHIJKLMNOPQRSTUVWXYZ[\]^_`abcdefghijklmnopqrstuvwxyz{|}~
//======================================================
const unsigned char code F8X16[]=
{
    0x00,0x00,0x00,0x00,0x00,0x00,0x00,0x00,0x00,0x00,0x00,0x00,0x00,0x00,0x00,0x00,// 0
    0x00,0x00,0x00,0xF8,0x00,0x00,0x00,0x00,0x00,0x00,0x00,0x33,0x30,0x00,0x00,0x00,//!1
    0x00,0x10,0x0C,0x06,0x10,0x0C,0x06,0x00,0x00,0x00,0x00,0x00,0x00,0x00,0x00,0x00,//"2
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    0x00,0x06,0x01,0x01,0x02,0x02,0x04,0x04,0x00,0x00,0x00,0x00,0x00,0x00,0x00,0x00,//~94
};


/*****************************************************************************
 函 数 名  : LCD_WrDat
 功能描述  : 向OLCD写数据
 输入参数  : unsigned char ucData  
 输出参数  : NONE
 返 回 值  : NONE
*****************************************************************************/
void LCD_WrDat(unsigned char ucData)
{
    unsigned char i = 8;
    LCD_DC   = 1;
    LCD_SCL  = 0;
    
    while (i--)
    {
        if (ucData & 0x80)
        {
            LCD_SDA = 1;
        }
        else
        {
            LCD_SDA = 0;
        }
        
        LCD_SCL = 1; 
        _nop_();
        LCD_SCL = 0;    
        ucData <<= 1;    
    }

    return;
}

/*****************************************************************************
 函 数 名  : LCD_WrCmd
 功能描述  : 向OLCD写命令
 输入参数  : unsigned char ucCmd  
 输出参数  : NONE
 返 回 值  : NONE
*****************************************************************************/
void LCD_WrCmd(unsigned char ucCmd)
{
    unsigned char i = 8;
    LCD_DC   = 0;
    LCD_SCL  = 0;
    while (i--)
    {
        if (ucCmd & 0x80)
        {
            LCD_SDA = 1;
        }
        else
        {
            LCD_SDA = 0;
        }
        LCD_SCL = 1;
        _nop_();           
        LCD_SCL = 0;    
        ucCmd <<= 1;   
    }  

    return;
}


/*****************************************************************************
 函 数 名  : LCD_SetPos
 功能描述  : 设置坐标
 输入参数  : unsigned char ucIdxX  
             unsigned char ucIdxY  
 输出参数  : NONE
 返 回 值  : NONE
*****************************************************************************/
void LCD_Set_Pos(unsigned char ucIdxX, unsigned char ucIdxY)
{ 
    LCD_WrCmd(0xb0 + ucIdxY);
    LCD_WrCmd(((ucIdxX & 0xf0) >> 4) | 0x10);
    LCD_WrCmd((ucIdxX & 0x0f) | 0x00); 
} 

/*　*　*　*　*bmp图片显示*　*　*　*　*/
void LCD_Fill(unsigned char bmp_data)
{
	unsigned char y,x;
	
	for(y=0;y<8;y++)
	{
		LCD_WrCmd(0xb0+y);
		LCD_WrCmd(0x01);
		LCD_WrCmd(0x10);
		for(x=0;x<X_WIDTH;x++)
			LCD_WrDat(bmp_data);
	}
}
/*　*　*　*　*OLED清屏*　*　*　*　*/
void LCD_CLS(void)
{
	unsigned char y,x;	
	for(y=0;y<8;y++)
	{
		LCD_WrCmd(0xb0+y);
		LCD_WrCmd(0x01);
		LCD_WrCmd(0x10); 
		for(x=0;x<X_WIDTH;x++)
			LCD_WrDat(0);
	}
}
/*　*　*　*　*OLED初始化*　*　*　*　*/
void LCD_Init(void)        
{ 
   	uint8 i = 0 ;
  
	LCD_SCL=1;
	LCD_CS=1;	//预制SLK和SS为高电平   	
	
	LCD_RST=0;
	for(i = 0; i < 100; i++)
    {
        _nop_();            //从上电到下面开始初始化要有足够的时间，即等待RC复位完毕      
    }
	LCD_CS=0;	
	LCD_RST=1;

    LCD_WrCmd(0xae);//--turn off oled panel
    LCD_WrCmd(0x00);//---set low column address
    LCD_WrCmd(0x10);//---set high column address
    LCD_WrCmd(0x40);//--set start line address  Set Mapping RAM Display Start Line (0x00~0x3F)
    LCD_WrCmd(0x81);//--set contrast control register
    LCD_WrCmd(0xcf); // Set SEG Output Current Brightness
    LCD_WrCmd(0xa1);//--Set SEG/Column Mapping     0xa0左右反置 0xa1正常
    LCD_WrCmd(0xc8);//Set COM/Row Scan Direction   0xc0上下反置 0xc8正常
    LCD_WrCmd(0xa6);//--set normal display
    LCD_WrCmd(0xa8);//--set multiplex ratio(1 to 64)
    LCD_WrCmd(0x3f);//--1/64 duty
    LCD_WrCmd(0xd3);//-set display offset	Shift Mapping RAM Counter (0x00~0x3F)
    LCD_WrCmd(0x00);//-not offset
    LCD_WrCmd(0xd5);//--set display clock divide ratio/oscillator frequency
    LCD_WrCmd(0x80);//--set divide ratio, Set Clock as 100 Frames/Sec
    LCD_WrCmd(0xd9);//--set pre-charge period
    LCD_WrCmd(0xf1);//Set Pre-Charge as 15 Clocks & Discharge as 1 Clock
    LCD_WrCmd(0xda);//--set com pins hardware configuration
    LCD_WrCmd(0x12);
    LCD_WrCmd(0xdb);//--set vcomh
    LCD_WrCmd(0x40);//Set VCOM Deselect Level
    LCD_WrCmd(0x20);//-Set Page Addressing Mode (0x00/0x01/0x02)
    LCD_WrCmd(0x02);//
    LCD_WrCmd(0x8d);//--set Charge Pump enable/disable
    LCD_WrCmd(0x14);//--set(0x10) disable
    LCD_WrCmd(0xa4);// Disable Entire Display On (0xa4/0xa5)
    LCD_WrCmd(0xa6);// Disable Inverse Display On (0xa6/a7) 
    LCD_WrCmd(0xaf);//--turn on oled panel
    LCD_Fill(0x00);  //初始清屏
    LCD_Set_Pos(0,0);  
	
} 


//==============================================================
//函数名：LCD_P6x8Str(unsigned char x,unsigned char y,unsigned char *p)
//功能描述：写入一组标准ASCII字符串
//参数：显示的位置（x,y），y为页范围0～7，要显示的字符串
//返回：无
//==============================================================  
void LCD_P6x8Str(unsigned char x,unsigned char y,unsigned char ch[])
{
  unsigned char c=0,i=0,j=0;      
  while (ch[j]!='\0')
  {    
    c =ch[j]-32;
    if(x>126){x=0;y++;}
    LCD_Set_Pos(x,y);    
  	for(i=0;i<6;i++)     
  	  LCD_WrDat(F6x8[c][i]);  
  	x+=6;
  	j++;
  }
}






//==============================================================
//函数名：LCD_P8x16Str(unsigned char x,unsigned char y,unsigned char *p)
//功能描述：写入一组标准ASCII字符串
//参数：显示的位置（x,y），y为页范围0～7，要显示的字符串
//返回：无
//==============================================================  
void LCD_P8x16Str(unsigned char x,unsigned char y,unsigned char ch[])
{
  unsigned char c=0,i=0,j=0;
        
  while (ch[j]!='\0')
  {    
    c =ch[j]-32;
    if(x>120){x=0;y++;}
    LCD_Set_Pos(x,y);    
  	for(i=0;i<8;i++)     
  	  LCD_WrDat(F8X16[c*16+i]);
  	LCD_Set_Pos(x,y+1);    
  	for(i=0;i<8;i++)     
  	  LCD_WrDat(F8X16[c*16+i+8]);  
  	x+=8;
  	j++;
  }
}





void LCD_PrintU16(unsigned char x,unsigned char y,unsigned int num)
{
	unsigned char tmp[6],i;
	tmp[5]=0;
	tmp[4]=(unsigned char)(num%10+0x30);
	tmp[3]=(unsigned char)(num/10%10+0x30);
	tmp[2]=(unsigned char)(num/100%10+0x30);
	tmp[1]=(unsigned char)(num/1000%10+0x30);
	tmp[0]=(unsigned char)(num/10000%10+0x30);
	
	for(i=0;i<4;i++)
	{
		if(tmp[i]=='0')
			tmp[i]=' ';
		else
			break;
	}
	
	LCD_P6x8Str(x,y,tmp);
	
}
